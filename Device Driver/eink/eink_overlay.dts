/dts-v1/;
/plugin/;
/ {
	compatible = "brcm,bcm2835";

	fragment@0 {
		target = <&spidev0>;
		__overlay__ {
			status = "disabled";
		};
	};
	
	fragment@1 {
		target = <&spi0>;
		__overlay__ {
			status = "okay";
			#address-cells = <1>;
			#size-cells = <0>;

			eink: eink@0 {
				compatible = "mikroe,eink";
				reg = <0x0>;
				spi-max-frequency = <1000000>;
				spi-bits-per-word = <8>;
				status = "okay";
				cs-gpios = <&gpio 22 0>;
				reset-gpios = <&gpio 27 0>;
                busy-gpios = <&gpio 5 0>;
				dc-gpios = <&gpio 6 0>;
			};
		};
	};
};	